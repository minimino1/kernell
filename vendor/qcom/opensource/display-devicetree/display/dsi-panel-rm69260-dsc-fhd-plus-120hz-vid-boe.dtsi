&mdss_mdp {
	dsi_rm69260_amoled_120hz_vid_boe: qcom,mdss_dsi_rm69260_120hz_fhd_plus_dsc_vid_boe {
		qcom,mdss-dsi-panel-name =
			"rm69260 amoled vid mode dsi boe panel with DSC";
		qcom,mdss-dsi-panel-type = "dsi_video_mode";
		qcom,mdss-dsi-panel-physical-type = "oled";
		qcom,mdss-dsi-virtual-channel-id = <0>;
		qcom,mdss-dsi-stream = <0>;
		qcom,mdss-dsi-bpp = <24>;
		qcom,mdss-dsi-color-order = "rgb_swap_rgb";
		qcom,mdss-dsi-underflow-color = <0xff>;
		qcom,mdss-dsi-border-color = <0>;
		qcom,dsi-ctrl-num = <0>;
		qcom,dsi-phy-num = <0>;
		qcom,mdss-dsi-traffic-mode = "non_burst_sync_event";
		qcom,mdss-dsi-bllp-power-mode;
		qcom,mdss-dsi-bllp-eof-power-mode;
		qcom,mdss-dsi-lane-map = "lane_map_0123";
		qcom,mdss-dsi-lane-0-state;
		qcom,mdss-dsi-lane-1-state;
		qcom,mdss-dsi-lane-2-state;
		qcom,mdss-dsi-lane-3-state;
		qcom,mdss-dsi-lp11-init;
		qcom,mdss-dsi-dma-trigger = "trigger_sw";
		qcom,mdss-dsi-mdp-trigger = "none";
		qcom,mdss-dsi-reset-sequence = <1 10>, <0 10>, <1 10>;
		qcom,mdss-pan-physical-width-dimension = <71>;
		qcom,mdss-pan-physical-height-dimension = <158>;
		qcom,mdss-dsi-display-timings {
			timing@0 {
				cell-index = <0>;
				qcom,mdss-dsi-panel-framerate = <144>;
				qcom,mdss-dsi-panel-width = <1260>;
				qcom,mdss-dsi-panel-height = <2800>;
				qcom,mdss-dsi-h-front-porch = <100>;
				qcom,mdss-dsi-h-back-porch = <12>;
				qcom,mdss-dsi-h-pulse-width = <4>;
				qcom,mdss-dsi-h-sync-skew = <0>;
				qcom,mdss-dsi-v-back-porch = <62>;
				qcom,mdss-dsi-v-front-porch = <76>;
				qcom,mdss-dsi-v-pulse-width = <2>;
				qcom,mdss-dsi-h-left-border = <0>;
				qcom,mdss-dsi-h-right-border = <0>;
				qcom,mdss-dsi-v-top-border = <0>;
				qcom,mdss-dsi-v-bottom-border = <0>;
				qcom,mdss-dsi-panel-jitter = <0x4 0x1>;
				qcom,vid-on-commands = [
					15 01 00 00 00 00 02 FE 46
					15 01 00 00 00 00 02 60 06
					15 01 00 00 00 00 02 FE 00
					15 01 00 00 00 00 02 37 00
					15 01 00 00 00 00 02 FA 01
					15 01 00 00 00 00 02 C1 03
					15 01 00 00 00 00 02 C2 03
					15 01 00 00 00 00 02 35 00
					05 01 00 00 78 00 01 11
					05 01 00 00 0a 00 01 29
				];
				qcom,mdss-dsi-on-command-state = "dsi_lp_mode";
				qcom,mdss-dsi-off-command = [
					15 01 00 00 23 00 02 FE 00
					05 01 00 00 50 00 01 28
					05 01 00 00 20 00 01 10
				];
				qcom,mdss-dsi-off-command-state = "dsi_lp_mode";
				qcom,mdss-dsi-switch-144hz-command = [
					15 01 00 40 00 00 02 FE 00
					15 01 00 00 00 00 02 37 00
				];
				qcom,mdss-dsi-switch-144hz-command-state = "dsi_hs_mode";
				qcom,mdss-dsi-switch-120hz-command = [
					15 01 00 40 00 00 02 FE 00
					15 01 00 00 00 00 02 37 01
				];
				qcom,mdss-dsi-switch-120hz-command-state = "dsi_hs_mode";
				qcom,mdss-dsi-switch-90hz-command = [
					15 01 00 40 00 00 02 FE 00
					15 01 00 00 00 00 02 37 03
				];
				qcom,mdss-dsi-switch-90hz-command-state = "dsi_hs_mode";
				qcom,mdss-dsi-switch-60hz-command = [
					15 01 00 40 00 00 02 FE 00
					15 01 00 00 00 00 02 37 04
				];
				qcom,mdss-dsi-switch-60hz-command-state = "dsi_hs_mode";
				qcom,mdss-dsi-switch-30hz-command = [
					15 01 00 40 00 00 02 FE 00
					05 01 00 00 00 00 01 39
				];
				qcom,mdss-dsi-switch-30hz-command-state = "dsi_hs_mode";
				qcom,mdss-dsi-exit-30hz-command = [
					15 01 00 40 00 00 02 FE 00
					05 01 00 00 00 00 01 38
				];
				qcom,mdss-dsi-exit-30hz-command-state = "dsi_hs_mode";
				qcom,mdss-dsi-lhbm-on-command = [
					15 01 00 40 00 00 02 FE 00
					15 01 00 40 00 00 02 37 02
					15 01 00 00 00 00 02 83 01];
				qcom,mdss-dsi-lhbm-on-command-state = "dsi_hs_mode";
				qcom,mdss-dsi-lhbm-off-command = [
					15 01 00 40 00 00 02 FE 00
					15 01 00 40 00 00 02 37 01
					15 01 00 00 00 00 02 83 00];
				qcom,mdss-dsi-lhbm-off-command-state = "dsi_hs_mode";
				qcom,mdss-dsi-switch-aod1-command = [
					15 01 00 40 00 00 02 FE 00
					39 01 00 00 00 00 03 51 3F FE];
				qcom,mdss-dsi-switch-aod1-command-state = "dsi_hs_mode";
				qcom,mdss-dsi-switch-aod2-command = [
					15 01 00 40 00 00 02 FE 00
					39 01 00 00 00 00 03 51 1D 19];
				qcom,mdss-dsi-switch-aod2-command-state = "dsi_hs_mode";
				qcom,mdss-dsi-switch-aod3-command = [
					15 01 00 40 00 00 02 FE 00
					39 01 00 00 00 00 03 51 00 04];
				qcom,mdss-dsi-switch-aod3-command-state = "dsi_hs_mode";
				qcom,mdss-dsc-version = <0x11>;
				qcom,compression-mode = "dsc";
				qcom,mdss-dsc-slice-height = <8>;
				qcom,mdss-dsc-slice-width = <630>;
				qcom,mdss-dsc-slice-per-pkt = <2>;
				qcom,mdss-dsc-bit-per-component = <8>;
				qcom,mdss-dsc-bit-per-pixel = <8>;
				qcom,mdss-dsc-block-prediction-enable;
			};
		};
	};
};
